## yocto/build/conf/bblayers.conf
```bitbake
# POKY_BBLAYERS_CONF_VERSION is increased each time build/conf/bblayers.conf
# changes incompatibly
POKY_BBLAYERS_CONF_VERSION = "2"

BBPATH = "${TOPDIR}"
BBFILES ?= ""

BBLAYERS ?= " \
  /xilinxworks/ZCU106/v2025.2/chopsync/yocto-prj/sources/poky/meta \
  /xilinxworks/ZCU106/v2025.2/chopsync/yocto-prj/sources/poky/meta-poky \
  /xilinxworks/ZCU106/v2025.2/chopsync/yocto-prj/sources/poky/../meta-openembedded/meta-oe \
  /xilinxworks/ZCU106/v2025.2/chopsync/yocto-prj/sources/poky/../meta-openembedded/meta-python \
  /xilinxworks/ZCU106/v2025.2/chopsync/yocto-prj/sources/poky/../meta-openembedded/meta-filesystems \
  /xilinxworks/ZCU106/v2025.2/chopsync/yocto-prj/sources/poky/../meta-openembedded/meta-networking \
  /xilinxworks/ZCU106/v2025.2/chopsync/yocto-prj/sources/poky/../meta-openembedded/meta-multimedia \
  /xilinxworks/ZCU106/v2025.2/chopsync/yocto-prj/sources/poky/../meta-openembedded/meta-webserver \
  /xilinxworks/ZCU106/v2025.2/chopsync/yocto-prj/sources/poky/../meta-virtualization \
  /xilinxworks/ZCU106/v2025.2/chopsync/yocto-prj/sources/poky/../meta-security \
  /xilinxworks/ZCU106/v2025.2/chopsync/yocto-prj/sources/poky/../meta-security/meta-tpm \
  /xilinxworks/ZCU106/v2025.2/chopsync/yocto-prj/sources/poky/../meta-xilinx/meta-xilinx-core \
  /xilinxworks/ZCU106/v2025.2/chopsync/yocto-prj/sources/poky/../meta-xilinx/meta-xilinx-standalone \
  /xilinxworks/ZCU106/v2025.2/chopsync/yocto-prj/sources/poky/../meta-xilinx/meta-xilinx-standalone-sdt \
  /xilinxworks/ZCU106/v2025.2/chopsync/yocto-prj/sources/poky/../meta-xilinx/meta-xilinx-multimedia \
  /xilinxworks/ZCU106/v2025.2/chopsync/yocto-prj/sources/poky/../meta-xilinx/meta-xilinx-demos \
  /xilinxworks/ZCU106/v2025.2/chopsync/yocto-prj/sources/poky/../meta-xilinx/meta-xilinx-virtualization \
  /xilinxworks/ZCU106/v2025.2/chopsync/yocto-prj/sources/poky/../meta-xilinx/meta-xilinx-mali400 \
  /xilinxworks/ZCU106/v2025.2/chopsync/yocto-prj/sources/poky/../meta-xilinx/meta-xilinx-gpu-malig78ae \
  /xilinxworks/ZCU106/v2025.2/chopsync/yocto-prj/sources/poky/../meta-xilinx/meta-microblaze \
  /xilinxworks/ZCU106/v2025.2/chopsync/yocto-prj/sources/poky/../meta-xilinx/meta-amd-zephyr \
  /xilinxworks/ZCU106/v2025.2/chopsync/yocto-prj/sources/poky/../meta-xilinx-tsn \
  /xilinxworks/ZCU106/v2025.2/chopsync/yocto-prj/sources/poky/../meta-openamp \
  /xilinxworks/ZCU106/v2025.2/chopsync/yocto-prj/sources/poky/../meta-amd-edf \
  /xilinxworks/ZCU106/v2025.2/chopsync/yocto-prj/sources/poky/../meta-amd-edf/meta-amd-edf-bsp \
  /xilinxworks/ZCU106/v2025.2/chopsync/yocto-prj/sources/poky/../meta-kria \
  /xilinxworks/ZCU106/v2025.2/chopsync/yocto-prj/sources/poky/../meta-amd-adaptive-socs/meta-amd-adaptive-socs-core \
  /xilinxworks/ZCU106/v2025.2/chopsync/yocto-prj/sources/poky/../meta-amd-adaptive-socs/meta-amd-adaptive-socs-bsp \
  /xilinxworks/ZCU106/v2025.2/chopsync/yocto-prj/sources/poky/../meta-xilinx/meta-xilinx-imgrcvry \
  /xilinxworks/ZCU106/v2025.2/chopsync/yocto-prj/sources/poky/../meta-arm/meta-arm \
  /xilinxworks/ZCU106/v2025.2/chopsync/yocto-prj/sources/poky/../meta-arm/meta-arm-toolchain \
  /xilinxworks/ZCU106/v2025.2/chopsync/yocto-prj/sources/poky/../meta-jupyter \
  /xilinxworks/ZCU106/v2025.2/chopsync/yocto-prj/sources/poky/../meta-ros/meta-ros-common \
  /xilinxworks/ZCU106/v2025.2/chopsync/yocto-prj/sources/poky/../meta-ros/meta-ros2 \
  /xilinxworks/ZCU106/v2025.2/chopsync/yocto-prj/sources/poky/../meta-ros/meta-ros2-jazzy \
  /xilinxworks/ZCU106/v2025.2/chopsync/yocto-prj/sources/poky/../meta-qt5 \
  /xilinxworks/ZCU106/v2025.2/chopsync/yocto-prj/sources/poky/../meta-vitis \
  /xilinxworks/ZCU106/v2025.2/chopsync/yocto-prj/sources/poky/../meta-zephyr/meta-zephyr-core \
  /xilinxworks/ZCU106/v2025.2/chopsync/yocto-prj/sources/poky/../meta-zephyr/meta-zephyr-bsp \
  /xilinxworks/ZCU106/v2025.2/chopsync/yocto-prj/sources/poky/../meta-rauc \
  /xilinxworks/ZCU106/v2025.2/chopsync/yocto-prj/sources/poky/../meta-system-controller \
  /xilinxworks/ZCU106/v2025.2/chopsync/yocto-prj/sources/meta-vivadoprj \
  /xilinxworks/ZCU106/v2025.2/chopsync/yocto-prj/sources/meta-user \
  "
```
